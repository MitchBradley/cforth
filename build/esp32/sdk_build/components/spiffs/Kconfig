## build/esp32/sdk_build/components/spiffs/Kconfig
```kconfig
menu "SPIffs Example Configuration"

config SPIFFS_LOG_BLOCK_SIZE
    int "Logical block size"
    range 4098 65536
    default 8192

config SPIFFS_BASE_ADDR
    hex "Base address"
    range 100000 1FFE000
    default 180000

config SPIFFS_SIZE
    int "Size"
    range 262144 2097152
    default 1048576

endmenu
```
