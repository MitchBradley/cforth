## src/app/esp32-extra/sdkconfig.defaults
```kconfig
# === Standaard ESP32 configuratie ===

# Platform
CONFIG_IDF_TARGET="esp32"

# Flash size (often: 4 MB)
CONFIG_ESPTOOLPY_FLASHMODE_QIO=y
CONFIG_ESPTOOLPY_FLASHFREQ_40M=y
CONFIG_ESPTOOLPY_FLASHSIZE_4MB=y

# Partition table (standard CSV in sdk_build)
CONFIG_PARTITION_TABLE_SINGLE_APP=y
CONFIG_PARTITION_TABLE_FILENAME="partitions.csv"

# Logging
CONFIG_LOG_DEFAULT_LEVEL_INFO=y
# (alternatieven: ERROR, WARN, DEBUG, VERBOSE)

# FreeRTOS settings
CONFIG_FREERTOS_UNICORE=y
CONFIG_FREERTOS_CORETIMER_0=y

# Console and IO
CONFIG_ESP_CONSOLE_UART_DEFAULT=y
CONFIG_ESP_CONSOLE_UART_BAUDRATE=115200

# Network
CONFIG_ESP_WIFI_ENABLED=y
```
